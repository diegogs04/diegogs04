;
; POSTLAB 2.asm
;
; Created: 2/15/2025 4:51:47 PM
; Author : diego
;


; Replace with your application code

.include"M328PDEF.inc"

.CSEG
.ORG 0x0000

//PILE SETUP 
LDI R16, LOW (RAMEND)
OUT SPL, R16
LDI R17, HIGH (RAMEND)
OUT SPH, R17

SEG: .DB 0x40, 0x79, 0x24, 0x30, 0x19, 0x12, 0x02, 0x78, 0x00, 0x10, 0x08, 0x03, 0x46, 0x21, 0x06, 0x0E


//SETUP 
SETUP: 
	CALL INIT_TM0
	LDI R20, 0 // VALOR PARA CONTADOR DE 10 ms
	LDI R19, 0 // VALOR INICIAL DEL CONTADOR
	LDI R23, 0 // VALOR INICIAL DE LA ALARMA 
	LDI R24, 0 // LНMITE CONTADOR BINARIO (BAJO) 
	LDI R22, 15// LНMITE CONTADOR BINARIO (ALTO) 
	LDI R16, (1 << CLKPCE)
	STS CLKPR, R16
	LDI R16, 0b0000_0111
	STS CLKPR, R16

	//DECLARACION DE INPUTS
	LDI R16, 0b0000_0110  // PULLUPS BOTONES
	OUT PORTB, R16   //SE ASIGNA EL VALOR DE R21 A PORTB PARA LOS PULLUPS
	LDI R16, 0b0111_1111 //PULLUPS 7-SEGMENTOS
	OUT DDRD, R16 // SE ASIGNA EL VALOR DE R21 A DDRD PARA LOS PULLUPS 
	LDI R16, 0b0001_1111//PULLUPS PARA CONTADOR
	OUT DDRC, R16// SE ASIGNA EL VALOR DE R21 A DDRC PARA LOS PULLUPS
	LDI R18, 0 // TIMER 7S
	LDI R21, 0 //VALOR INICIAL 7S 
	LDI ZH, HIGH (SEG << 1)
	LDI ZL, LOW (SEG << 1)
	ADD ZL, R18
	LPM R18, Z

//CICLO 
CICLO: 
	SBRC R18, PC4
	SBI  PINC, PC5
	OUT PORTD, R18
	CBI PORTC, PC4
	IN R16, PINB
	SBRS R16, PB2  // SI SE PRESIONA EL BOTON VA AL ANTIREBOTE
	RJMP AB_1
	IN R17, PINB 
	SBRS R17, PB1
	RJMP AB_2
	IN R16, TIFR0
	SBRS R16, OCF0A // SALTA SI OCF0A COINCIDE CON R16
	RJMP CICLO 
	SBI TIFR0, OCF0A
	INC R20
	CPI R20, 1
	BRNE CICLO 
	CLR R20
	SBI PINB, PB3
	CPSE R19,R22
	CALL LUC
	LDI R19, 0
	OUT PORTC, R19
	CPSE R23, R24
	SBI PORTC, PC4
	RJMP CICLO 

INIT_TM0:
	LDI R16, 0
	OUT TCNT0, R16
	LDI R16, 156
	OUT OCR0A, R16
	LDI R16, (1 << WGM01)
	OUT TCCR0A, R16
	LDI R16, (1 << CS02)|(1 << CS00)
	OUT TCCR0B, R16
	RET
	
AB_1:
	LDI R16, 100  // SE LE ASIGNA VALOR A VARIABLE PARA QUE CUENTE HACIA ABAJO
	DELAY1: 
		DEC R16 //RESTA 1 A R22
		BRNE DELAY1
	SBIS PINB, PB2 //SALTA SI EL VALOR ES 1
	RJMP AB_1
	CALL SUM

AB_2:
	LDI R17, 100  // SE LE ASIGNA VALOR A VARIABLE PARA QUE CUENTE HACIA ABAJO
	DELAY2: 
		DEC R17 //RESTA 1 A R22
		BRNE DELAY2
	SBIS PINB, PB1 //SALTA SI EL VALOR ES 1
	RJMP AB_2
	CALL RES

SUM: 
	CPSE R21,R22
	INC R21
	MOV R18, R21
	LDI ZH, HIGH (SEG << 1)
	LDI ZL, LOW (SEG << 1)
	ADD ZL, R18
	LPM R18,Z
	RJMP CICLO

RES: 
	CPSE R21, R24
	DEC R21
	MOV R18,R21
	LDI ZH, HIGH(SEG << 1)
	LDI ZL, LOW (SEG << 1)
	ADD ZL, R18
	LPM R18, Z
	RJMP CICLO 

ALRM: 
	CPSE R23, R24
	CALL WN_OFF
	LDI R23, 15
	SBI PORTC, PC4
	LDI R19, 15
	RJMP CICLO 

LUC:
	INC R19
	OUT PORTC, R19
	CPSE R23,R24
	SBI PORTC, PC4
	CPSE R19,R21
	RJMP CICLO
	CALL ALRM

WN_OFF: 
	LDI R23, 0
	LDI R19, 15
	RJMP CICLO
	 
	


