;Universidad del Valle de Guatemala
;Diego Alejandro Benjamín García Soto 
;Carné: 23787
; Sumador.asm
;
; Created: 2/9/2025 10:06:32 PM
; Author : diego
;

.include "M328PDEF.inc"
.cseg
.org 0x00
//pila

LDI R16,LOW(RAMEND)
OUT SPL,R16
LDI R17,HIGH(RAMEND)
OUT SPH,R17

//SETUP

SETUP: 
	LDI R20,(1 <<CLKPCE)
	STS CLKPR,R20
	LDI R20,0B000_0100
	STS CLKPR,R20
//OUTPUTS
	LDI R16,0b0000_1111 ; OUTPUTS CONTADORES PB Y PC
	LDI R22,0b0111_1111 ; OUTPUT RESULTADO PD
	OUT DDRB,R16        ; PB ESTABLECIDO COMO OUTPUT
	OUT DDRC,R16        ; PC ESTABLECIDO COMO OUTPUT
	OUT DDRD,R22        ; PD ESTABLECIDO COMO OUTPUT
	LDI R17,0           ; CONTADOR 1 EN 0
	LDI R21,0           ; CONTADOR 2 EN 0 
	LDI R23,0           ; RESULTADO EN 0
CICLO:
	OUT PORTC,R17
	OUT PORTB,R21
	OUT PORTD,R23
	SBIC PINC,PC4
	CALL S_1
	SBIC PINC,PC5
	CALL M_1
	SBIC PINB,PB4
	CALL S_2
	SBIC PINB,PB5
	CALL M_2
	SBIC PIND,PD7
	CALL RES
	RJMP CICLO
S_1:
	CALL DELAY
	INC R17
	OUT PORTC,R17
	RJMP CICLO
M_1:
	CALL DELAY 
	DEC R17
	OUT PORTC,R17
	RJMP CICLO
S_2:
	CALL DELAY
	INC R21
	OUT PORTB,R21
	RJMP CICLO 
M_2:
	CALL DELAY 
	DEC R21
	OUT PORTB,R21
	RJMP CICLO 

DELAY:
	LDI R18,0
	LDI R19,0
RES:
	CALL DELAY 
	MOV R23,R17
	ADD R23,R21
	LSL R23
	LSL R23
	OUT PORTD,R23
	RJMP CICLO
ABOUNCE:
	INC R18
	CPI R18,0
	BRNE ABOUNCE 
	INC R19
	CPI R19,0
	BRNE ABOUNCE
	RET
